## drivers/hid/asus-ally-hid/Kconfig
```kconfig
config ASUS_ALLY_HID
	tristate "Asus Ally handheld support"
	depends on USB_HID
	depends on LEDS_CLASS
	depends on LEDS_CLASS_MULTICOLOR
	select POWER_SUPPLY
	help
	Support for configuring the Asus ROG Ally gamepad using attributes.
```

## drivers/kdbus/Kconfig
```kconfig
config KDBUS
	tristate "kdbus interprocess communication"
	help
	  D-Bus is a system for low-latency, low-overhead, easy to use
	  interprocess communication (IPC).
	  http://dbus.freedesktop.org/doc/dbus-specification.html
```

## fs/reiser4/Kconfig
```kconfig
config REISER4_FS
	tristate "Reiser4 (EXPERIMENTAL)"
	select ZLIB_INFLATE
	select ZLIB_DEFLATE
	select LZO_COMPRESS
	select LZO_DECOMPRESS
	select CRYPTO
	help
	  Reiser4 is a filesystem that performs all filesystem operations
	  as atomic transactions, which means that it either performs a
	  write, or it does not, and in the event of a crash it does not
	  partially perform it or corrupt it.

	  It stores files in dancing trees, which are like balanced trees but
	  faster.  It packs small files together so that they share blocks
	  without wasting space.  This means you can use it to store really
	  small files.  It also means that it saves you disk space.  It avoids
	  hassling you with anachronisms like having a maximum number of
	  inodes, and wasting space if you use less than that number.

	  Reiser4 is a distinct filesystem type from reiserfs (V3).
	  It's therefore not possible to use reiserfs file systems
	  with reiser4.

	  To learn more about reiser4, go to http://www.namesys.com

config REISER4_DEBUG
	bool "Enable reiser4 debug mode"
	depends on REISER4_FS
	help
	  Don't use this unless you are debugging reiser4.

	  If unsure, say N.
```

## kernel/Kconfig.MuQSS
```kconfig
choice
	prompt "CPU scheduler runqueue sharing"
	default RQ_MC if SCHED_MUQSS
	default RQ_NONE

config RQ_NONE
	bool "No sharing"
	help
	  This is the default behaviour where the CPU scheduler has one runqueue
	  per CPU, whether it is a physical or logical CPU (hyperthread).

	  This can still be enabled runtime with the boot parameter
	  rqshare=none

	  If unsure, say N.

config RQ_SMT
	bool "SMT (hyperthread) siblings"
	depends on SCHED_SMT && SCHED_MUQSS

	help
	  With this option enabled, the CPU scheduler will have one runqueue
	  shared by SMT (hyperthread) siblings. As these logical cores share
	  one physical core, sharing the runqueue resource can lead to decreased
	  overhead, lower latency and higher throughput.

	  This can still be enabled runtime with the boot parameter
	  rqshare=smt

	  If unsure, say N.

config RQ_MC
	bool "Multicore siblings"
	depends on SCHED_MC && SCHED_MUQSS
	help
	  With this option enabled, the CPU scheduler will have one runqueue
	  shared by multicore siblings in addition to any SMT siblings.
	  As these physical cores share caches, sharing the runqueue resource
	  will lead to lower latency, but its effects on overhead and throughput
	  are less predictable. As a general rule, 6 or fewer cores will likely
	  benefit from this, while larger CPUs will only derive a latency
	  benefit. If your workloads are primarily single threaded, this will
	  possibly worsen throughput. If you are only concerned about latency
	  then enable this regardless of how many cores you have.

	  This can still be enabled runtime with the boot parameter
	  rqshare=mc

	  If unsure, say Y.

config RQ_SMP
	bool "Symmetric Multi-Processing"
	depends on SMP && SCHED_MUQSS
	help
	  With this option enabled, the CPU scheduler will have one runqueue
	  shared by all physical CPUs unless they are on separate NUMA nodes.
	  As physical CPUs usually do not share resources, sharing the runqueue
	  will normally worsen throughput but improve latency. If you only
	  care about latency enable this.

	  This can still be enabled runtime with the boot parameter
	  rqshare=smp

	  If unsure, say N.

config RQ_ALL
	bool "NUMA"
	depends on SMP && SCHED_MUQSS
	help
	  With this option enabled, the CPU scheduler will have one runqueue
	  regardless of the architecture configuration, including across NUMA
	  nodes. This can substantially decrease throughput in NUMA
	  configurations, but light NUMA designs will not be dramatically
	  affected. This option should only be chosen if latency is the prime
	  concern.

	  This can still be enabled runtime with the boot parameter
	  rqshare=all

	  If unsure, say N.
endchoice

config SHARERQ
	int
	default 0 if RQ_NONE
	default 1 if RQ_SMT
	default 2 if RQ_MC
	default 3 if RQ_SMP
	default 4 if RQ_ALL
```
